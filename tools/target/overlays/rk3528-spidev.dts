/dts-v1/;
/plugin/;

/ {
    fragment@0 {
        target = <&spi1>;

        __overlay__ {
            #address-cells = <1>;
            #size-cells = <0>;

            pinctrl-names = "default";
            pinctrl-0 = <&spi1_pins &spi1_csn0>;
            status = "okay";

            spidev@0 {
                compatible = "rohm,dh2228fv";
                reg = <0>;
                spi-max-frequency = <10000000>;
            };
        };
    };
};
